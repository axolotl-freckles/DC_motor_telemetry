## libs/DC_model/Kconfig
```kconfig
menu "DC Motor Plant Model"
	menu "Plant Parameters"
		config DC_MODEL_PLANT_RESISTANCE
			int "Resistance of the DC Motor (xE-3)"
			default 6600
			help Resistance in ohms of the DC Motor.
				The integer value set here is going to be multiplied by 1e-3 for the
				simulation.
		config DC_MODEL_PLANT_INDUCTANCE
			int "Inductance of the DC Motor (xE-6)"
			default 8150
			help Inductance in Henrs of the DC Motor.
				The integer value set here is going to be multiplied by 1e-6 for the
				simulation.
		config DC_MODEL_PLANT_MOMENT_OF_INERCIA
			int "Moment of inercia of the DC Motor (xE-3)"
			default 6
			help Moment of inercia in kg/m2 of the DC Motor.
				The integer value set here is going to be multiplied by 1e-3 for the
				simulation.
	endmenu
	config DC_MODEL_OVERRIDE_OBSERVER_PARAMS
		bool "Override default observer params"
		default false
	menu "Observer Parameters"
		depends on DC_MODEL_OVERRIDE_OBSERVER_PARAMS
		config DC_MODEL_OBSERVER_ALFA_1
			int "Alfa 1 (xE-6)"
			default -10
		config DC_MODEL_OBSERVER_ALFA_2
			int "Alfa 2 (xE-6)"
			default -10
		config DC_MODEL_OBSERVER_ALFA_3
			int "Alfa 3 (xE-3)"
			default -1000
		config DC_MODEL_OBSERVER_K1
			int "K1 (xE-9)"
			default 1
		config DC_MODEL_OBSERVER_K2
			int "K2 (xE-9)"
			default 1
		config DC_MODEL_OBSERVER_K3
			int "K3 (xE-6)"
			default 100000
	endmenu
endmenu
```

## libs/controller/Kconfig
```kconfig
menu "Control Law"
	menu "PID"
		config CONTROL_PID_KP
			int "Proportional gain (xE-3)"
			default 800
		config CONTROL_PID_KI
			int "Integral gain (xE-3)"
			default 200
		config CONTROL_PID_KD
			int "Integral gain (xE-3)"
			default 0
	endmenu
	menu "Ideal Control Law"
		config CONTROL_LQR_K1
			int "LQR K1 gain (xE-3)"
			default 3175
		config CONTROL_LQR_K2
			int "LQR K2 gain (xE-3)"
			default 415
		config CONTROL_LQR_KI
			int "LQR Ki gain (xE-3)"
			default 98
		config CONTROL_LQR_NU
			int "LQR Nu gain (xE-3)"
			default 456
	endmenu
endmenu
```

## libs/controller_task/Kconfig
```kconfig
menu "Controller Task"
	choice CONTROLLER_TASK_CONTROLLER_TYPE
		prompt "Controller type"
		default CONTROLLER_TASK_CONTROLLER_TYPE_LQR
		config CONTROLLER_TASK_CONTROLLER_TYPE_OPEN_LOOP
			bool "Open Loop"
		config CONTROLLER_TASK_CONTROLLER_TYPE_PID
			bool "PID"
		config CONTROLLER_TASK_CONTROLLER_TYPE_LQR
			bool "Ideal Control Law (LQR)"
	endchoice
endmenu
```

## libs/globals/Kconfig.projbuild
```kconfig
menu "DC Motor Telemetry general settings"
	config MOTOR_TELEMETRY_SAMPLE_TIME_ms
		int "Sample Time (ms)"
		default 10
		help
			Sample time of the control loop in milliseconds.
	config MOTOR_TELEMETRY_MODEL_SIM_TIME_us
		int "Simulation Time (us)"
		default 200
		help
			Sample time of the sliding filter observer in microseconds.
endmenu
```

## libs/telemetry_task/Kconfig
```kconfig
menu "Telemetry"
	config TELEMETRY_WIFI_SSID
		string "Telemetry SSID"
		help
			The SSID of the network used for sending telemetry.
	config TELEMETRY_WIFI_PASSWORD
		string "Telemetry password"
		help
			Password to connect to the network.
	config TELEMETRY_SERVER_IP
		string "Telemetry server IP"
		default "127.0.0.1"
		help
			IP address of the telemetry server.
			This is where the telemetry is going to be sent to.
	config TELEMETRY_SERVER_PORT
		string "Telemetry server port"
		default "8080"
		help
			The port where the telemetry server is going to be listening or
			sending the setpoint from.
endmenu
```

## main/Kconfig.projbuild
```kconfig
choice BUILD_MODE
	prompt "Build mode"
	default CONTROLLER_BUILD_MODE_CONTROL
	config CONTROLLER_BUILD_MODE_CONTROL
		bool "Control"
	config CONTROLLER_BUILD_MODE_FUNCTION_MEASUREMENT
		bool "Function measurement"
endchoice
```
